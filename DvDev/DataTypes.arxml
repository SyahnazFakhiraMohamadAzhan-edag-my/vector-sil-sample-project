AUTOSAR XML (schema 00049)
standard types defined: dtRef_const_VOID, dtRef_VOID, boolean, float32, float64, sint16, sint16_least, sint32, sint32_least, sint64, sint8, sint8_least, uint16, uint16_least, uint32, uint32_least, uint64, uint8, uint8_least, boolean_CompuMethod, boolean_DataConstr, float32_DataConstr, float64_DataConstr, sint16_DataConstr, sint16_least_DataConstr, sint32_DataConstr, sint32_least_DataConstr, sint64_DataConstr, sint8_DataConstr, sint8_least_DataConstr, uint16_DataConstr, uint16_least_DataConstr, uint32_DataConstr, uint32_least_DataConstr, uint64_DataConstr, uint8_DataConstr, uint8_least_DataConstr, Boolean
package /ComponentTypes/DataTypeMappingSets
  data type mapping set TheTypeMappingSet: data-type-map{application-data-type=ADT_Temperature, implementation-data-type=float32}
package /Predefined_DEV/ImplementationDataTypes
  impl type NvM_RequestResultType: compu {0=NVM_REQ_OK, 1=NVM_REQ_NOT_OK, 2=NVM_REQ_PENDING, 3=NVM_REQ_INTEGRITY_FAILED, 4=NVM_REQ_BLOCK_SKIPPED, 5=NVM_REQ_NV_INVALIDATED, 6=NVM_REQ_CANCELED, 7=NVM_REQ_REDUNDANCY_FAILED, 8=NVM_REQ_RESTORED_FROM_ROM}, implementation-data-type=ImplementationDataTypes/uint8
  impl type NvM_ServiceIdType: compu {6=NVM_READ_BLOCK, 7=NVM_WRITE_BLOCK, 8=NVM_RESTORE_BLOCK_DEFAULTS, 9=NVM_ERASE_BLOCK, 11=NVM_INVALIDATE_NV_BLOCK, 12=NVM_READ_ALL}, implementation-data-type=ImplementationDataTypes/uint8
  impl type Dem_UdsStatusByteType: compu {mask 1: 1=DEM_UDS_STATUS_TF, mask 2: 2=DEM_UDS_STATUS_TFTOC, mask 4: 4=DEM_UDS_STATUS_PDTC, mask 8: 8=DEM_UDS_STATUS_CDTC, mask 16: 16=DEM_UDS_STATUS_TNCSLC, mask 32: 32=DEM_UDS_STATUS_TFSLC, mask 64: 64=DEM_UDS_STATUS_TNCTOC, mask 128: 128=DEM_UDS_STATUS_WIR}, range raw 0..255, implementation-data-type=ImplementationDataTypes/uint8
package /DataTypes
  impl type ErrorCodeLightCtrl: category=VALUE, base-type=BaseTypes/uint8, sw-calibration-access=READ-ONLY, compu {0=NoError, 1=ErrorLightIntensity, 2=ErrorLightSwitch, 3=ErrorThreshold, 4=ErrorInvalidState}, type-emitter=RTE
  impl type LightSwitchEncoded: compu {0=Cx0_Off, 1=Cx1_On, 2=Cx2_Auto, 3=Cx3_SNA} "Source signal range: [0,2]", implementation-data-type=ImplementationDataTypes/uint8, type-emitter=RTE
  impl type HeadLightEncoded: compu {0=Cx0_Off, 1=Cx1_On}, implementation-data-type=ImplementationDataTypes/uint8, type-emitter=RTE
  app type ADT_Temperature: category=VALUE, sw-calibration-access=READ-ONLY, compu {phys=raw*1.8+32 for raw -100..200, else 72; unit Degree}
package /DataTypes/CompuMethods
  compu method CM_Intensity: phys=raw*100 for raw 0..1; unit Degree
package /DataTypes/Units
  unit Degree: display-name=Degree, factor-si-to-unit=1
package /DataType/Constraint
  range DC_HeadLight: raw 0..1
  range DC_LightSwitch: raw 0..3
package /MICROSAR_SWCS_DEV/IoHwAb_swc/DataTypes/DataConstrs
  range uint16_Constr: raw 0..65535
