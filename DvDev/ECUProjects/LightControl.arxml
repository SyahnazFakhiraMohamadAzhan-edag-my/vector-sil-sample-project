AUTOSAR XML (schema 00049)
package /ECUCompositionTypes
  composition sw component type ECU_Composition
    component ErrorHandler: type=ErrorHandler
    component LightCtrl: type=LightCtrl
    connect LightCtrl.Error -> ErrorHandler.Error
package /EndToEndProtections
  end to end protection set EndToEndConnections
package /VehicleProject
  system System
    system mapping System_MPPNG
    root-software-compositions:
      root sw composition prototype ECU_Composition: software-composition=ECU_Composition
