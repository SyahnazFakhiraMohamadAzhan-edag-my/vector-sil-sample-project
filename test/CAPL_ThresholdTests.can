/*@!Encoding:65001*/
// Testcase: Setting Thresholds To Invalid Values Or Incompatible Combinations
includes
{
  #include "CAPL_TestingFunctions.cin"
}

variables
{
  // Initialize all mandatory variables. Avoid initialization of variables in functions.
  const int cHystOnDelay = 2000;  // Hysteresis time when switching on
  const int cHystOffDelay = 3000; // Hysteresis time when switching off
  const int cEpsilon = 100;       // cycleTime
  int plannedOffThreshold;
  int plannedOnThreshold;

  // Initialization of helper and placeholder variables
  long ret;
  long checkErrorCode; 

  struct TestSetup
  {
    int initialLightIntensity;    // Light intensity before test start
    int testLightIntensity;       // Light intensity during test
    int initialLightSwitchState;  // Switch position before test start
    int testLightSwitchState;     // Switch position during test
    int initialHeadlightState;    // Headlight state before test start
    int testHeadLightState;       // Planned/Expected headlight state during test
  };
  
  struct TestSetup InvThreshChange_TS = {0, 0, 2, 2, 1, 1};
  struct TestSetup Thresh_Auto_TS_Rise = {0, 51, 2, 2, 1, 0};
  struct TestSetup Thresh_Auto_TS_Drop = {1000, 29, 2, 2, 0, 1};

  // Call contexts for threshold tests
  callContext LightControl_DO::BFC.LightCtrl.CalThreshold.Threshold_LightIntensityToOn.Write ccoOn; 
  callContext LightControl_DO::BFC.LightCtrl.CalThreshold.Threshold_LightIntensityToOff.Write ccoOff;
  
  char msgBuff [200];
}
void Callback_checkErrorCodeThrsh(dword check)
{
  testCaseComment("ThresholdErrorCheck failed as expected!");
}

export testcase InvalidThresholdChange(){
  testCaseTitle("", "InvalidThresholdChange");
  // Test setup and assurance
  testStep(0, "1.0", "Test setup: Setting thresholds to invalid values or incompatible combinations.");

  Initialize();
  checkErrorCode = ChkStart_SignalValueChange (LightControl_DO::BFC.LightCtrl.Error.ErrorCode, "Callback_checkErrorCodeThrsh");

  // Setting symbols according to configuration
  plannedOnThreshold = 22;
  plannedOffThreshold = 11;
  ccoOn = LightControl_DO::BFC.LightCtrl.CalThreshold.Threshold_LightIntensityToOn.Write.CallAsync(plannedOnThreshold);
  ccoOff = LightControl_DO::BFC.LightCtrl.CalThreshold.Threshold_LightIntensityToOff.Write.CallAsync(plannedOffThreshold);
  if ((testWaitForAnswer(ccoOn, cEpsilon) != 1) || (testWaitForAnswer(ccoOff, cEpsilon) != 1)){
    testCaseFail();
    return;
  }
  ret = waitForThresholdState(11, 22, 100);
  if (ret != 0){
    snprintf(msgBuff, elcount(msgBuff), "Setup of test could not be achieved because thresholds were not set (return: %d).", ret);
    testStepFail(1, "1.0", msgBuff);
    return;
  }
  sysSetVariableInt(sysvar::Interface::LightIntensity, InvThreshChange_TS.initialLightIntensity);
  ret = setupAndValidate(InvThreshChange_TS.initialLightSwitchState, InvThreshChange_TS.initialHeadlightState, cEpsilon, cEpsilon);
  if (ret != 0){
    snprintf(msgBuff, elcount(msgBuff), "Setup of test could not be achieved because LightSwitch and Headlight could not be set (return: %d).", ret);
    testStepFail(1, "1.0", msgBuff);
    return;
  }
  testStepPass(1, "1.0", "Setup of test was achieved.");
  // Start testing
  testStep(0, "2.0", "Test: Headlight should react even though error occurs. Error should be raised.");

  sysSetVariableInt(sysvar::Interface::LightIntensity, InvThreshChange_TS.testLightIntensity);
  ret = setupAndValidate(InvThreshChange_TS.testLightSwitchState, InvThreshChange_TS.testHeadLightState, cEpsilon, cEpsilon);
  if (ret == 1){  
    testStepFail(1, "2.0", "Test failed because lightswitch couldn't be set correctly.");
    return;
  }
  if (ret == 2) {
    testStepFail(1, "2.0", "Test failed because headlight state changed.");
    return;
  }
  testStepPass(1, "2.0", "Start of test succeeded. Lightswitch in position, headlight is ON.");

  testStep(0, "3.0", "Test : \"ErrorThreshold\" should have been raised.");
  ret = ChkQuery_NumEvents(checkErrorCode);
  if (ret != 1){  
    testStepFail(1, "3.0", "Test failed because error was not raised.");
    return;
  }
  testValidateImplValueUInt("3.0: Expecting ThresholdError", LightControl_DO::BFC.LightCtrl.Error.ErrorCode, 3);

  ChkControl_Reset(checkErrorCode);
  ChkControl_Destroy(checkErrorCode);
  testStepPass(1, "3.0", "Test passed. Threshold was set and error raised.");
  // Reset ECU to ensure clean environment
  Initialize();
}


export testcase Threshold_AUTO_LightIntensityRise(){
  // Test setup with new thresholds
  testStep(0, "1.0", "Test setup: Auto mode should work with different thresholds and LightIntensity rise.");

  Initialize();
  plannedOnThreshold = 30;
  plannedOffThreshold = 50;
  ccoOn = LightControl_DO::BFC.LightCtrl.CalThreshold.Threshold_LightIntensityToOn.Write.CallAsync(plannedOnThreshold);
  ccoOff = LightControl_DO::BFC.LightCtrl.CalThreshold.Threshold_LightIntensityToOff.Write.CallAsync(plannedOffThreshold);
  if ((testWaitForAnswer(ccoOn, cEpsilon) != 1) || (testWaitForAnswer(ccoOff, cEpsilon) != 1)){
    testCaseFail();
    return;
  }
  ret = waitForThresholdState(plannedOffThreshold, plannedOnThreshold, cEpsilon);
  if (ret != 0){
    testStepFail(1, "1.0", "Setup of test could not be achieved.");
    return;
  }

  sysSetVariableInt(sysvar::Interface::LightIntensity, Thresh_Auto_TS_Rise.initialLightIntensity);
  ret = setupAndValidate(Thresh_Auto_TS_Rise.initialLightSwitchState, Thresh_Auto_TS_Rise.initialHeadlightState, cEpsilon, cEpsilon);
  if (ret != 0){
    testStepFail(1, "1.0", "Setup of test could not be achieved.");
    return;
  }
  testStepPass(1, "1.0", "Setup of test was achieved.");
  
  // Start testing
  testStep(0, "2.0", "Test: Light should not turn off for hysteresis time after lightintensity rise.");
  sysSetVariableInt(sysvar::Interface::LightIntensity, Thresh_Auto_TS_Rise.testLightIntensity);
  
  ret = testWaitForChange(LightControl_DO::BFC.LightCtrl.Output.HeadLight, cHystOffDelay);
  
  if (ret != 0){
    testStepFail(1, "2.0", "Test failed because headlight state changed in hysteresis time or error occurred.");
    return;
  }
  testStepPass(1, "2.0", "Start of test succeeded. Headlight stayed on.");
  
  testStep(1, "3.0", "Test: Reaction test. Expecting light to turn off.");
  ret = waitForHeadlightState(Thresh_Auto_TS_Rise.testHeadlightState, cEpsilon);
  if (ret != 1){
    testStepFail(0,"3.0", "Headlights did not turn off.");
    return;
  }
  testStepPass(0, "3.0", "Headlight turned off after correct time.");
}

// AUTO-Mode Testcase: Light Should Turn ON In Hysteresis Time When Lightintensity Drops Under Threshold 
export testcase Threshold_AUTO_LightIntensityDrop(){
  // Test setup and assurance
  testStep(0, "1.0", "Test setup: Auto mode should work with different thresholds and LightIntensity drop.");

  plannedOnThreshold = 30;
  plannedOffThreshold = 50;
  ccoOn = LightControl_DO::BFC.LightCtrl.CalThreshold.Threshold_LightIntensityToOn.Write.CallAsync(plannedOnThreshold);
  ccoOff = LightControl_DO::BFC.LightCtrl.CalThreshold.Threshold_LightIntensityToOff.Write.CallAsync(plannedOffThreshold);
  if ((testWaitForAnswer(ccoOn, cEpsilon) != 1) || (testWaitForAnswer(ccoOff, cEpsilon) != 1)){
    testCaseFail();
    return;
  }
  ret = waitForThresholdState(plannedOffThreshold, plannedOnThreshold, cEpsilon);
  if (ret != 0){
    testStepFail(1, "1.0", "Setup of test could not be achieved.");
    return;
  }
  sysSetVariableInt(sysvar::Interface::LightIntensity, Thresh_Auto_TS_Drop.initialLightIntensity);
  ret = setupAndValidate(Thresh_Auto_TS_Drop.initialLightSwitchState, Thresh_Auto_TS_Drop.initialHeadlightState, cEpsilon, cEpsilon);
  if (ret != 0){
    testStepFail(1, "1.0", "Setup of test could not be achieved.");
    return;
  }
  testStepPass(1, "1.0", "Setup of test was achieved.");
  
  // Start testing
  testStep(0, "2.0", "Test: Light should turn on in hysteresis time after lightintensity drop.");
  sysSetVariableInt(sysvar::Interface::LightIntensity, Thresh_Auto_TS_Drop.testLightIntensity);
  testWaitForTimeout(cEpsilon); // Cycle time and hysteresis variation
  ret = waitForHeadlightState(Thresh_Auto_TS_Drop.testHeadlightState, cHystOnDelay);
  if (ret != 1){
    testStepFail(0, "2.0", "Headlights did not turn on or error occurred.");
    return;
  }
  testStepPass(0, "2.0", "Headlight turned on instantly.");
}